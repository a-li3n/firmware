/\*----------------------------------------------------------------------------/
 Lovyan GFX - Graphics library for embedded devices.

Original Source:
 https://github.com/lovyan03/LovyanGFX/

Licence:
 \[FreeBSD\](https://github.com/lovyan03/LovyanGFX/blob/master/license.txt)

Author:
 \[lovyan03\](https://twitter.com/lovyan03)

Contributors:
 \[ciniml\](https://github.com/ciniml)
 \[mongonta0716\](https://github.com/mongonta0716)
 \[tobozo\](https://github.com/tobozo)
/----------------------------------------------------------------------------\*/
#if defined (ESP\_PLATFORM)
#include
#if defined (CONFIG\_IDF\_TARGET\_ESP32S3)

#include "Panel\_RGB.hpp"
#include "../../Bus.hpp"
#include "../common.hpp"

#include "Bus\_RGB.hpp"

#include
#include

namespace lgfx
{
 inline namespace v1
 {
//----------------------------------------------------------------------------

 Panel\_RGB::Panel\_RGB(void)
 {
 \_write\_depth = color\_depth\_t::rgb565\_2Byte;
 \_read\_depth = color\_depth\_t::rgb565\_2Byte;
 // \_write\_depth = color\_depth\_t::rgb332\_1Byte;
 // \_read\_depth = color\_depth\_t::rgb332\_1Byte;
 }

 Panel\_RGB::~Panel\_RGB(void)
 {
 deinitFrameBuffer();
 }

 bool Panel\_RGB::init(bool use\_reset)
 {
 if (!Panel\_FrameBufferBase::init(use\_reset)) { return false; }

 auto h = \_cfg.panel\_height;

 auto frame\_buffer\_ = \_bus->getDMABuffer(0);
 size\_t lineArray\_size = h \* sizeof(void\*);
 uint8\_t\*\* lineArray = (uint8\_t\*\*)heap\_alloc\_dma(lineArray\_size);

 if (lineArray)
 {
 \_lines\_buffer = lineArray;
 memset(lineArray, 0, lineArray\_size);

 uint8\_t bits = \_write\_bits;
 int w = (\_cfg.panel\_width + 3) & ~3;
 if (frame\_buffer\_) {
 auto fb = frame\_buffer\_;
 for (int i = 0; i < h; ++i) {
 lineArray\[i\] = fb;
 fb += w \* bits >> 3;
 }

 int32\_t pin\_cs = \_config\_detail.pin\_cs;
 if (pin\_cs >= 0) {
 lgfx::gpio\_hi(pin\_cs);
 lgfx::pinMode(pin\_cs, pin\_mode\_t::output);
 }

 return true;
 }
 heap\_free(lineArray);
 }

 return false;
 }
/\*
 static inline uint8\_t\* sub\_heap\_alloc(bool flg\_psram, size\_t size)
 {
 uint8\_t\* res = nullptr;
 if (flg\_psram) { res = (uint8\_t\*)heap\_alloc\_psram(size); }
 if (res == nullptr)
 {
 res = (uint8\_t\*)heap\_alloc\_dma(size);
 }
 if (res) { memset(res, 0, size); }
 return (uint8\_t\*)res;
 }
\*/

 bool Panel\_RGB::initFrameBuffer(uint\_fast16\_t w, uint\_fast16\_t h, color\_depth\_t depth, uint8\_t chunk\_lines, uint8\_t use\_psram)
 {
 size\_t lineArray\_size = h \* sizeof(void\*);
// ESP\_LOGE("DEBUG","height:%d", h);
 uint8\_t\*\* lineArray = (uint8\_t\*\*)heap\_alloc\_dma(lineArray\_size);
 if (lineArray)
 {
 memset(lineArray, 0, lineArray\_size);

 uint8\_t bits = (depth & color\_depth\_t::bit\_mask);
 w = (w + 3) & ~3;
// 暫定実装。画面全体のバッファを一括で確保する。
// ToDo : 分割確保
 \_frame\_buffer = (uint8\_t\*)heap\_alloc\_psram((w \* bits >> 3) \* h);
 if (\_frame\_buffer) {
 \_lines\_buffer = lineArray;
 auto fb = \_frame\_buffer;
 for (int i = 0; i < h; ++i) {
 lineArray\[i\] = fb;
 fb += w \* bits >> 3;
 }
 return true;
 }
 heap\_free(lineArray);
 }
 return false;
 }

 void Panel\_RGB::deinitFrameBuffer(void)
 {
 if (\_frame\_buffer)
 {
 heap\_free(\_frame\_buffer);
 \_frame\_buffer = nullptr;
 }

 if (\_lines\_buffer)
 {
 heap\_free(\_lines\_buffer);
 \_lines\_buffer = nullptr;
 }
 }

 static void \_write\_swspi(uint32\_t data, uint8\_t bits, uint8\_t pin\_sclk, uint8\_t pin\_mosi)
 {
 uint\_fast8\_t mask = 1 << (bits - 1);
 do
 {
 gpio\_lo(pin\_sclk);
 if (data & mask) { gpio\_hi(pin\_mosi); } else { gpio\_lo(pin\_mosi); }
 gpio\_hi(pin\_sclk);
 } while (mask >>= 1);
 }

 void Panel\_RGB::writeCommand(uint32\_t data, uint\_fast8\_t len)
 {
 do
 {
// printf("CMD: %02x \\n", data & 0xFF);
 \_write\_swspi(data & 0xFF, 9, \_config\_detail.pin\_sclk, \_config\_detail.pin\_mosi);
 data >>= 8;
 } while (--len);
 }

 void Panel\_RGB::writeData(uint32\_t data, uint\_fast8\_t len)
 {
 do
 {
// printf("DAT: %02x \\n", data & 0xFF);
 \_write\_swspi(data \| 0x100, 9, \_config\_detail.pin\_sclk, \_config\_detail.pin\_mosi);
 data >>= 8;
 } while (--len);
 }

//\-\-\-\-\-\-\-\-\-\-\-\-\-\-\-\-\-\-\-\-\-\-\-\-\-\-\-\-\-\-\-\-\-\-\-\-\-\-\-\-\-\-\-\-\-\-\-\-\-\-\-\-\-\-\-\-\-\-\-\-\-\-\-\-\-\-\-\-\-\-\-\-\-\-\-\-
 /\\* Panel ST7701 base initialization \*/
 bool Panel\_ST7701\_Base::init(bool use\_reset)
 {
 if (!Panel\_RGB::init(use\_reset))
 {
 return false;
 }

 int32\_t pin\_mosi = \_config\_detail.pin\_mosi;
 int32\_t pin\_sclk = \_config\_detail.pin\_sclk;
 if (pin\_mosi >= 0 && pin\_sclk >= 0)
 {
 lgfx::gpio::pin\_backup\_t backup\_pins\[\] = { (gpio\_num\_t)pin\_mosi, (gpio\_num\_t)pin\_sclk };

 lgfx::gpio\_lo(pin\_mosi);
 lgfx::pinMode(pin\_mosi, pin\_mode\_t::output);
 lgfx::gpio\_lo(pin\_sclk);
 lgfx::pinMode(pin\_sclk, pin\_mode\_t::output);

 int32\_t pin\_cs = \_config\_detail.pin\_cs;
 lgfx::gpio\_lo(pin\_cs);

 writeCommand(0xFF, 1);
 writeData(0x77, 1);
 writeData(0x01, 1);
 writeData(0x00, 2);
 writeData(0x10, 1);

 // 0xC0 : LNSET : Display Line Setting
 writeCommand(0xC0, 1);
 uint32\_t line1 = (\_cfg.panel\_height >> 3) + 1;
 uint32\_t line2 = (\_cfg.panel\_height >> 1) & 3;
 writeData(line1 + (line2 ? 0x80 : 0x00), 1);
 writeData(line2, 1);

 // 0xC3 : RGBCTRL
 auto cfg = ((Bus\_RGB\*)\_bus)->config();
 writeCommand(0xC3, 1);
 uint32\_t rgbctrl = 0;
 if ( cfg.de\_idle\_high ) rgbctrl += 0x01;
 if ( cfg.pclk\_idle\_high) rgbctrl += 0x02;
 if (!cfg.hsync\_polarity) rgbctrl += 0x04;
 if (!cfg.vsync\_polarity) rgbctrl += 0x08;
 writeData(rgbctrl, 1);
 writeData(0x10, 1);
 writeData(0x08, 1);

 for (uint8\_t i = 0; auto cmds = getInitCommands(i); i++)
 {
 command\_list(cmds);
 }

 lgfx::gpio\_hi(pin\_cs);
 for (auto &bup : backup\_pins) { bup.restore(); }
 }

 return true;
 }

 const uint8\_t\* Panel\_ST7701::getInitCommands(uint8\_t listno) const
 {
 static constexpr const uint8\_t list0\[\] =
 {
 // Command2 BK0 SEL
 0xFF, 5, 0x77, 0x01, 0x00, 0x00, 0x10,

 0xC1, 2, 0x0D, 0x02,
 0xC2, 2, 0x31, 0x05,
 0xCD, 1, 0x08,

 // Positive Voltage Gamma Control
 0xB0, 16, 0x00, 0x11, 0x18, 0x0E, 0x11, 0x06, 0x07, 0x08,
 0x07, 0x22, 0x04, 0x12, 0x0F, 0xAA, 0x31, 0x18,

 // Negative Voltage Gamma Control
 0xB1, 16, 0x00, 0x11, 0x19, 0x0E, 0x12, 0x07, 0x08, 0x08,
 0x08, 0x22, 0x04, 0x11, 0x11, 0xA9, 0x32, 0x18,

 // Command2 BK1 SEL
 0xFF, 5, 0x77, 0x01, 0x00, 0x00, 0x11,

 0xB0, 1, 0x60, // Vop=4.7375v
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 0xFF, 0xFF, 0xFF, 0x20, 0x45, 0x67, 0x98, 0xBA,

 //-----------VAP & VAN---------------
 // Command2 BK3 SEL
 0xFF, 5, 0x77, 0x01, 0x00, 0x00, 0x13,

 0xE5, 1, 0xE4,

 // Command2 BK0 SEL
 0xFF, 5, 0x77, 0x01, 0x00, 0x00, 0x00,

 0x21, 0, // 0x20 normal, 0x21 IPS
 0x3A, 1, 0x60, // 0x70 RGB888, 0x60 RGB666, 0x50 RGB565

 0x11, CMD\_INIT\_DELAY, 120, // Sleep Out

 0x29, 0, // Display On

 0xFF, 0xFF,
 };
 switch (listno)
 {
 case 0: return list0;
 default: return nullptr;
 }
 }

 const uint8\_t\* Panel\_ST7701\_guition\_esp32\_4848S040::getInitCommands(uint8\_t listno) const
 {
 static constexpr const uint8\_t list0\[\] =
 {
 // Command2 BK0 SEL
 0xFF, 5, 0x77, 0x01, 0x00, 0x00, 0x10,

 0xC0, 2, 0x3B, 0x00, // added by manufacture
 0xC1, 2, 0x0D, 0x02,
 0xC2, 2, 0x31, 0x05,
 0xCD, 1, 0x00, // changed by manufacture

 // Positive Voltage Gamma Control
 0xB0, 16, 0x00, 0x11, 0x18, 0x0E, 0x11, 0x06, 0x07, 0x08,
 0x07, 0x22, 0x04, 0x12, 0x0F, 0xAA, 0x31, 0x18,

 // Negative Voltage Gamma Control
 0xB1, 16, 0x00, 0x11, 0x19, 0x0E, 0x12, 0x07, 0x08, 0x08,
 0x08, 0x22, 0x04, 0x11, 0x11, 0xA9, 0x32, 0x18,

 // Command2 BK1 SEL
 0xFF, 5, 0x77, 0x01, 0x00, 0x00, 0x11,

 0xB0, 1, 0x60, // Vop=4.7375v
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 0xFF, 0xFF, 0xFF, 0x20, 0x45, 0x67, 0x98, 0xBA,

 //-----------VAP & VAN---------------
 // Command2 BK3 SEL
 0xFF, 5, 0x77, 0x01, 0x00, 0x00, 0x13,

 0xE5, 1, 0xE4,

 // Command2 BK0 SEL
 0xFF, 5, 0x77, 0x01, 0x00, 0x00, 0x00,

 //0x21, 0, // 0x20 normal, 0x21 IPS // commented by manufacture
 0x3A, 1, 0x60, // 0x70 RGB888, 0x60 RGB666, 0x50 RGB565

 0x11, CMD\_INIT\_DELAY, 120, // Sleep Out

 0x29, 0, // Display On

 0xFF, 0xFF,
 };
 switch (listno)
 {
 case 0: return list0;
 default: return nullptr;
 }
 }

//----------------------------------------------------------------------------

 const uint8\_t\* Panel\_GC9503::getInitCommands(uint8\_t listno) const
 {
 static constexpr const uint8\_t list0\[\] =
 {
 0xF0, 5, 0x55, 0xAA, 0x52, 0x08, 0x00,
 0xF6, 2, 0x5A, 0x87,
 0xC1, 1, 0x3F,
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 0x3a, 1, 0x66,

 0x11, CMD\_INIT\_DELAY, 200, // Sleep Out

 0x29, 0,
 0xFF, 0xFF
 };
 switch (listno)
 {
 case 0: return list0;
 default: return nullptr;
 }
 }

 bool Panel\_GC9503::init(bool use\_reset)
 {
 if (!Panel\_RGB::init(use\_reset))
 {
 return false;
 }

 int32\_t pin\_mosi = \_config\_detail.pin\_mosi;
 int32\_t pin\_sclk = \_config\_detail.pin\_sclk;
 if (pin\_mosi >= 0 && pin\_sclk >= 0)
 {
 lgfx::gpio::pin\_backup\_t backup\_pins\[\] = { (gpio\_num\_t)pin\_mosi, (gpio\_num\_t)pin\_sclk };
 lgfx::gpio\_lo(pin\_mosi);
 lgfx::pinMode(pin\_mosi, pin\_mode\_t::output);
 lgfx::gpio\_lo(pin\_sclk);
 lgfx::pinMode(pin\_sclk, pin\_mode\_t::output);

 int32\_t pin\_cs = \_config\_detail.pin\_cs;
 lgfx::gpio\_lo(pin\_cs);

 for (uint8\_t i = 0; auto cmds = getInitCommands(i); i++)
 {
 command\_list(cmds);
 }

 lgfx::gpio\_hi(pin\_cs);
 for (auto &bup : backup\_pins) { bup.restore(); }
 }

 return true;
 }

 }
}
#endif
#endif